## sources/linux-3.18.31/linux-3.18.31/Documentation/devicetree/bindings/input/parrot,mpp2_gamepad.txt
```
Parrot MPP2 gamepad driver

The Parrot MPP2 gamepad interfaces joyticks with the Soc using ADC.
This drivers provides sysfs entries to set the min, max, thresold, center, deadzone values
for each of the following logical input:
- joystick_left_x
- joystick_left_y
- joystick_right_x
- joystick_right_y
- rotary_left
- rotary_right

These parameters can be set according to the result of the calibration (joystick and rotary).
There is an addictionnal entry "use_raw_value" that permits to perform a calibration
without resetting the parameters of each of the logical channels mentionned above.

This driver also provides a debugfs interface to test the driver by generating
input events (EV_KEY, EV_ABS).


Required properties:
- compatible:		Must be "parrot,mpp2_gamepad"
- adc-channel-names:	Specified the gamepad inputs name associated the ADC inputs.
			Possible values:
			"joystick-left-x", "joystick-left-y", "joystick-right-x",
			"joystick-right-y", "rotary-left", "rotary-right".

- adc-channels:		Specified the ADC inputs associated with the igamepad inputs.

- adc-chip:		Reference of the ADC chip used for convertion
			Possible values: "adc088s022" and "ads7959"

Optional Properties:
- max-samples :		Number of samples used to compute the average on each channel sampled,
			in order to get a more precise values.
			By default it is set to 1.
			Possible values: from 1 to 10

Example:

	spi_mpp2_gamepad@1 {
		compatible = "parrot, mpp2_gamepad";
		max-samples = <5>;
		adc-channels = <1>, <3>, <0>, <5>, <6>, <0>;
		adc-channel-names = "joystick-left-x",
			"joystick-left-y",
			"joystick-right-x",
			"joystick-right-y",
			"rotary-left",
			"rotary-right";

		adc-chip = "ads7959";

		use-ads7959;

		reg = <1>;
		spi-max-frequency = <960000>;
		spi-cs-high;
	};
```

## sources/linux-3.18.31/linux-3.18.31/drivers/parrot/Kconfig
```kconfig
menuconfig PARROT
	bool "Parrot drivers"
	default n

if PARROT

source "drivers/parrot/gpio/Kconfig"

endif #PARROT
```
